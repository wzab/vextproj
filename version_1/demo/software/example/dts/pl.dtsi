/*
 * CAUTION: This file is automatically generated by Xilinx.
 * Version:  
 * Today is: Sat May  7 21:41:06 2016
*/


/ {
	amba_pl: amba_pl {
		#address-cells = <1>;
		#size-cells = <1>;
		compatible = "simple-bus";
		ranges ;
		axil2ipb_0: axil2ipb@40000000 {
			compatible = "xlnx,axil2ipb-1.0";
			reg = <0x40000000 0x4000>;
		};
	};
};
